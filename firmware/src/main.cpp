// Plant sensor node: wake up, read the sensors, POST one reading to the
// server, then deep-sleep until the next measurement. All the logic runs in
// setup(); every wake-up is a fresh boot.

#include <Arduino.h>
#include <ArduinoJson.h>
#include <BH1750.h>
#include <DHT.h>
#include <HTTPClient.h>
#include <WiFi.h>
#include <WiFiClientSecure.h>
#include <Wire.h>

#include "config.h"
#include "secrets.h"
#include "root_ca.h"  // generated by build.sh from firmware/root_ca.pem

static BH1750 lightMeter(BH1750_ADDRESS);
static DHT dht(DHT_PIN, DHT22);

struct Reading {
  float temperature = NAN;
  float humidity = NAN;
  float lux = NAN;
  int soilRaw = -1;
};

// Requires WiFi to be in STA mode so the MAC is available.
static String deviceId() {
#ifdef DEVICE_ID
  return DEVICE_ID;
#else
  uint8_t mac[6];
  WiFi.macAddress(mac);
  char id[16];
  snprintf(id, sizeof id, "plant-%02x%02x%02x", mac[3], mac[4], mac[5]);
  return id;
#endif
}

static int readSoilRaw() {
  analogSetPinAttenuation(SOIL_PIN, ADC_11db);  // full 0-3.3 V range
  uint32_t sum = 0;
  for (int i = 0; i < SOIL_SAMPLES; i++) {
    sum += analogRead(SOIL_PIN);
    delay(5);
  }
  return sum / SOIL_SAMPLES;
}

static float readLux() {
  if (!lightMeter.begin(BH1750::ONE_TIME_HIGH_RES_MODE)) {
    Serial.println("BH1750 not found");
    return NAN;
  }
  uint32_t start = millis();
  while (!lightMeter.measurementReady(true)) {
    if (millis() - start > 1000) return NAN;
    delay(10);
  }
  float lux = lightMeter.readLightLevel();
  return lux < 0 ? NAN : lux;
}

static Reading readSensors() {
  Reading r;
#if SENSOR_POWER_PIN >= 0
  pinMode(SENSOR_POWER_PIN, OUTPUT);
  digitalWrite(SENSOR_POWER_PIN, HIGH);
  delay(100);
#endif
  Wire.begin(I2C_SDA_PIN, I2C_SCL_PIN);
  dht.begin();

  r.lux = readLux();
  r.soilRaw = readSoilRaw();

  // The DHT22 needs ~2 s after power-up and at most one read per 2 s.
  for (int attempt = 0; attempt < 2 && (isnan(r.temperature) || isnan(r.humidity)); attempt++) {
    delay(2100);
    r.temperature = dht.readTemperature();
    r.humidity = dht.readHumidity();
  }

#if SENSOR_POWER_PIN >= 0
  digitalWrite(SENSOR_POWER_PIN, LOW);
#endif
  return r;
}

static bool connectWifi() {
  WiFi.begin(WIFI_SSID, WIFI_PASSWORD);
  uint32_t start = millis();
  while (WiFi.status() != WL_CONNECTED) {
    if (millis() - start > WIFI_TIMEOUT_MS) return false;
    delay(100);
  }
  return true;
}

static bool sendReading(const String& id, const Reading& r) {
  JsonDocument doc;
  doc["device_id"] = id;
  // Failed sensors are sent as null so the rest of the reading still counts.
  if (!isnan(r.temperature)) doc["temperature"] = r.temperature; else doc["temperature"] = nullptr;
  if (!isnan(r.humidity)) doc["humidity"] = r.humidity; else doc["humidity"] = nullptr;
  if (!isnan(r.lux)) doc["lux"] = r.lux; else doc["lux"] = nullptr;
  if (r.soilRaw >= 0) doc["soil_raw"] = r.soilRaw; else doc["soil_raw"] = nullptr;
  doc["rssi"] = WiFi.RSSI();

  String body;
  serializeJson(doc, body);
  Serial.println(body);

  String url = String(SERVER_URL) + "/api/readings";
  bool https = url.startsWith("https://");
  if (https && strlen(ROOT_CA) == 0) {
    // Never send the device key over an unverified TLS connection.
    Serial.println("SERVER_URL is https but no root_ca.pem was built in");
    return false;
  }

  for (int attempt = 1; attempt <= HTTP_RETRIES; attempt++) {
    WiFiClient plain;
    WiFiClientSecure secure;
    if (https) secure.setCACert(ROOT_CA);
    HTTPClient http;
    http.setTimeout(HTTP_TIMEOUT_MS);
    http.begin(https ? static_cast<WiFiClient&>(secure) : plain, url);
    http.addHeader("Content-Type", "application/json");
    http.addHeader("X-Api-Key", DEVICE_KEY);
    int code = http.POST(body);
    http.end();
    if (code >= 200 && code < 300) return true;
    Serial.printf("POST attempt %d failed: %d\n", attempt, code);
    delay(1000);
  }
  return false;
}

static void sleepUntilNextMeasurement() {
  Serial.printf("Sleeping %d s\n", MEASURE_INTERVAL_S);
  Serial.flush();
  esp_sleep_enable_timer_wakeup((uint64_t)MEASURE_INTERVAL_S * 1000000ULL);
  esp_deep_sleep_start();
}

void setup() {
  Serial.begin(115200);

  // Measure before turning the radio on: less self-heating and ADC noise.
  Reading reading = readSensors();

  WiFi.mode(WIFI_STA);
  String id = deviceId();
  Serial.printf("Device %s: T=%.1f°C RH=%.1f%% lux=%.0f soil_raw=%d\n", id.c_str(),
                reading.temperature, reading.humidity, reading.lux, reading.soilRaw);

  if (!connectWifi()) {
    Serial.println("WiFi connection failed");
  } else if (sendReading(id, reading)) {
    Serial.println("Reading sent");
  } else {
    Serial.println("Giving up on this reading");
  }

  WiFi.disconnect(true);
  WiFi.mode(WIFI_OFF);
  sleepUntilNextMeasurement();
}

void loop() {}
